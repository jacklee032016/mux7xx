## uboot/arch/arm/mach-at91/Kconfig
```kconfig
if ARCH_AT91

choice
	prompt "Atmel AT91 board select"
	optional


config TARGET_SAMA5D2_XPLAINED
	bool "SAMA5D2 Xplained board"
	select CPU_V7
	select SUPPORT_SPL
	select BOARD_EARLY_INIT_F
	select BOARD_LATE_INIT

# this used in board/atmel/muxlab7xx, then that defines BOARD and CONFIG_NAME to create include/config.h
# Jack Lee
config TARGET_MUXLAB_7XX
	bool "MuxLab 7xx board"
	select CPU_V7
	select BOARD_EARLY_INIT_F
	select BOARD_LATE_INIT

#	select SUPPORT_SPL


endchoice

config SYS_SOC
	default "at91"

source "board/atmel/sama5d2_xplained/Kconfig"
source "board/atmel/muxlab7xx/Kconfig"

endif
```

## uboot/board/atmel/muxlab7xx/Kconfig
```kconfig
if TARGET_MUXLAB_7XX

config SYS_BOARD
	default "muxlab7xx"

config SYS_VENDOR
	default "atmel"

config SYS_SOC
	default "at91"

config SYS_CONFIG_NAME
	default "muxlab7xx"

endif
```

## uboot/drivers/mux7xx/rtl8307h/Kconfig
```kconfig
menu "M500774 init support"

config M500774
	bool "enable m500774 support function"


endmenu
```
